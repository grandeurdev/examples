## esp8266/esp8266_rtos_sdk/mqtt/components/wifi/Kconfig.projbuild
```kconfig
menu "WiFi Configuration"

    config WIFI_SSID
        string "WiFi SSID"
        default "myssid"
        help
            SSID (network name) for the app to connect to.

    config WIFI_PASS
        string "WiFi Password"
        default "mypassword"
        help
            WiFi password (WPA or WPA2) for the app to use.

    config WIFI_MAXIMUM_RETRY
        int "Maximum retry"
        default 10
        help
            Set the Maximum retry to avoid station reconnecting to the AP unlimited when the AP is really inexistent.
endmenu
```

## esp8266/esp8266_rtos_sdk/mqtt/main/Kconfig.projbuild
```kconfig
menu "Grandeur Configuration"

    config API_KEY
        string "API Key"
        default "apiKey"
        help
            API Key for the app to use while connecting to Grandeur.

    config AUTH_TOKEN
        string "Auth Token"
        default "authtoken"
        help
            Auth token for the app to use while connecting to Grandeur.
endmenu
```
